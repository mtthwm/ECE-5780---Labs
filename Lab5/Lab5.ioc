# file: Lab5.ioc
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Mcu.Family=STM32F0
Mcu.Name=STM32F072R(8-B)Tx
Mcu.Package=LQFP64
ProjectManager.HeapSize=0x200
ProjectManager.StackSize=0x400
ProjectManager.TargetToolchain=MDK-ARM V5
board=custom

// file: Core/Src/main.c
/* USER CODE BEGIN Header */
/**
  ******************************************************************************
  * @file           : main.c
  * @brief          : Main program body
  ******************************************************************************
  * @attention
  *
  * Copyright (c) 2024 STMicroelectronics.
  * All rights reserved.
  *
  * This software is licensed under terms that can be found in the LICENSE file
  * in the root directory of this software component.
  * If no LICENSE file comes with this software, it is provided AS-IS.
  *
  ******************************************************************************
  */
/* USER CODE END Header */
#include "main.h"

void SystemClock_Config(void);

/* USER CODE BEGIN 0 */

#define GYRO_ADDR 0x69
#define GYRO_WHO_AM_I_REG 0x0F
#define GYRO_CTRL_REG1 0x20
#define GYRO_OUT_X_L_REG 0x28
#define GYRO_OUT_X_H_REG 0x29
#define GYRO_OUT_Y_L_REG 0x2A
#define GYRO_OUT_Y_H_REG 0x2B

#define MAX_ITERATIONS 100

#define TILT_THRESHOLD 0x0FFF

static int gyro_ok;

void config_red () {
	GPIOC->MODER &= ~(GPIO_MODER_MODER6_Msk);
	GPIOC->MODER |= GPIO_MODER_MODER6_0;
	GPIOC->OTYPER &= ~(GPIO_OTYPER_OT_6);
	GPIOC->OSPEEDR &= ~(GPIO_OSPEEDR_OSPEEDR6_Msk);
	GPIOC->PUPDR &= ~(GPIO_PUPDR_PUPDR6_Msk);
	GPIOC->ODR &= ~GPIO_ODR_6;
}
void toggle_red (char mode) {
	switch (mode) {
		case 2:
			GPIOC->ODR ^= GPIO_ODR_6;
			break;
		case 1:
			GPIOC->ODR |= GPIO_ODR_6;
			break;
		case 0:
			GPIOC->ODR &= ~GPIO_ODR_6;
			break;
	}
}
void config_blue () {
	GPIOC->MODER &= ~(GPIO_MODER_MODER7_Msk);
	GPIOC->MODER |= GPIO_MODER_MODER7_0;
	GPIOC->OTYPER &= ~(GPIO_OTYPER_OT_7);
	GPIOC->OSPEEDR &= ~(GPIO_OSPEEDR_OSPEEDR7_Msk);
	GPIOC->PUPDR &= ~(GPIO_PUPDR_PUPDR7_Msk);
	GPIOC->ODR &= ~GPIO_ODR_7;
}
void toggle_blue (char mode) {
	switch (mode) {
		case 2:
			GPIOC->ODR ^= GPIO_ODR_7;
			break;
		case 1:
			GPIOC->ODR |= GPIO_ODR_7;
			break;
		case 0:
			GPIOC->ODR &= ~GPIO_ODR_7;
			break;
	}
}
void config_orange () {
	GPIOC->MODER &= ~(GPIO_MODER_MODER8_Msk);
	GPIOC->MODER |= GPIO_MODER_MODER8_0;
	GPIOC->OTYPER &= ~(GPIO_OTYPER_OT_8);
	GPIOC->OSPEEDR &= ~(GPIO_OSPEEDR_OSPEEDR8_Msk);
	GPIOC->PUPDR &= ~(GPIO_PUPDR_PUPDR8_Msk);
	GPIOC->ODR &= ~GPIO_ODR_8;
}
void toggle_orange (char mode) {
	switch (mode) {
		case 2:
			GPIOC->ODR ^= GPIO_ODR_8;
			break;
		case 1:
			GPIOC->ODR |= GPIO_ODR_8;
			break;
		case 0:
			GPIOC->ODR &= ~GPIO_ODR_8;
			break;
	}
}
void config_green () {
	GPIOC->MODER &= ~(GPIO_MODER_MODER9_Msk);
	GPIOC->MODER |= GPIO_MODER_MODER9_0;
	GPIOC->OTYPER &= ~(GPIO_OTYPER_OT_9);
	GPIOC->OSPEEDR &= ~(GPIO_OSPEEDR_OSPEEDR9_Msk);
	GPIOC->PUPDR &= ~(GPIO_PUPDR_PUPDR9_Msk);
	GPIOC->ODR &= ~GPIO_ODR_9;
}
void toggle_green (char mode) {
	switch (mode) {
		case 2:
			GPIOC->ODR ^= GPIO_ODR_9;
			break;
		case 1:
			GPIOC->ODR |= GPIO_ODR_9;
			break;
		case 0:
			GPIOC->ODR &= ~GPIO_ODR_9;
			break;
	}
}

char i2c_write (char follower, char num_bytes, char* data) {
	for (char i = 0; i < num_bytes; i++) {
		I2C2->CR2 &= ~I2C_CR2_RD_WRN; // Set to write mode
		I2C2->CR2 |= (follower << (I2C_CR2_SADD_Pos + 1)); // Select follower address
		I2C2->CR2 |= (1 << I2C_CR2_NBYTES_Pos); // Set the number of bytes
		I2C2->CR2 |= I2C_CR2_START; // Start the transaction

		// Wait until we get either a NACK or a confirmation
		while (1) {
			if (I2C2->ISR & I2C_ISR_TXE) {
				break;
			}
			if (I2C2->ISR & I2C_ISR_NACKF_Msk) {
				return 0;
			}
			HAL_Delay(1);
		};

		// Input data to send
		I2C2->TXDR = data[i];

		// Wait until we receive confirmation that the data was sent.
		while (1) {
			if (I2C2->ISR & I2C_ISR_TC) {
				break;
			}
			HAL_Delay(1);
		}
	}
	return 1;
}

char i2c_read_byte (char follower) {
	// Prepare a read operation
	I2C2->CR2 |= (follower << (I2C_CR2_SADD_Pos + 1)); // Select follower address
	I2C2->CR2 |= (1 << I2C_CR2_NBYTES_Pos); // Set the number of bytes
	I2C2->CR2 |= I2C_CR2_RD_WRN; // Set to read mode
	I2C2->CR2 |= I2C_CR2_START; // Start the transaction

	// Wait until we get either a NACK or a confirmation
	int count = 0;
	while (count++ < MAX_ITERATIONS) {
		if (I2C2->ISR & I2C_ISR_RXNE) {
			break;
		}
		if (I2C2->ISR & I2C_ISR_NACKF_Msk) {
			return NULL;
		}
		HAL_Delay(1);
	};

	count = 0;
	while(count++ < MAX_ITERATIONS) {
		if (I2C2->ISR & I2C_ISR_TC) {
			return I2C2->RXDR;
		}
	}

	return NULL;
}

int config_gyro () {
	// Write the address of the WHO_AM_I register.
	char buff[8];
	buff[0] = GYRO_WHO_AM_I_REG;
	int status = i2c_write(GYRO_ADDR, 1, buff);
	if (!status) {
		return 0;
	}

	// Read the value at the address we just sent. It should be 0xD3
	char chip_id = i2c_read_byte(GYRO_ADDR);
	if (chip_id != 0xD3) {
		return 0;
	}

	// Enable the X and Y axes
	buff[0] = GYRO_CTRL_REG1;
	buff[1] = 0xF;
	status = i2c_write(GYRO_ADDR, 2, buff);
	if (!status) {
		return 0;
	}

	return 1;
}

void get_gyro_data (int16_t* x, int16_t* y) {
	char buff[1];
	buff[0] = GYRO_OUT_X_L_REG;
	i2c_write(GYRO_ADDR, 1, buff);
	int16_t x_lo = i2c_read_byte(GYRO_ADDR);
	buff[0] = GYRO_OUT_X_H_REG;
	i2c_write(GYRO_ADDR, 1, buff);
	int16_t x_hi = i2c_read_byte(GYRO_ADDR);
	buff[0] = GYRO_OUT_Y_L_REG;
	i2c_write(GYRO_ADDR, 1, buff);
	int16_t y_lo = i2c_read_byte(GYRO_ADDR);
	buff[0] = GYRO_OUT_Y_H_REG;
	i2c_write(GYRO_ADDR, 1, buff);
	int16_t y_hi = i2c_read_byte(GYRO_ADDR);

	*x = x_hi << 8 | x_lo;
	*y = y_hi << 8 | y_lo;
}

void update_leds_from_gyro_data (int16_t rot_x, int16_t rot_y) {
	get_gyro_data(&rot_x, &rot_y);
	if (rot_x > TILT_THRESHOLD) {
		toggle_green(1);
		toggle_orange(0);
	}
	if (rot_x < -TILT_THRESHOLD) {
		toggle_green(0);
		toggle_orange(1);
	}
	if (rot_y > TILT_THRESHOLD) {
		toggle_red(1);
		toggle_blue(0);
	}
	if (rot_y < -TILT_THRESHOLD) {
		toggle_red(0);
		toggle_blue(1);
	}
}

/* USER CODE END 0 */

int main(void)
{

  /* MCU Configuration--------------------------------------------------------*/

  /* Reset of all peripherals, Initializes the Flash interface and the Systick. */
  HAL_Init();

  /* USER CODE BEGIN Init */

	// Enable clock
	RCC->AHBENR |= RCC_AHBENR_GPIOBEN;
	RCC->AHBENR |= RCC_AHBENR_GPIOCEN;
	RCC->APB1ENR |= RCC_APB1ENR_I2C2EN;

	// Set GPIO 11 and 13 to use their alternate function mode
	GPIOB->MODER &= ~(GPIO_MODER_MODER11_Msk);
	GPIOB->MODER &= ~(GPIO_MODER_MODER13_Msk);
	GPIOB->MODER |= (2 << GPIO_MODER_MODER11_Pos);
	GPIOB->MODER |= (2 << GPIO_MODER_MODER13_Pos);

	// Set pins 11 and 13 to open drain
	GPIOB->OTYPER |= GPIO_OTYPER_OT_11;
	GPIOB->OTYPER |= GPIO_OTYPER_OT_13;

	// Configure GPIO pins for SDA and SCL
	GPIOB->AFR[1] &= ~GPIO_AFRH_AFSEL11_Msk;
	GPIOB->AFR[1] |= (1 << GPIO_AFRH_AFSEL11_Pos); // SDA
	GPIOB->AFR[1] &= ~GPIO_AFRH_AFSEL13_Msk;
	GPIOB->AFR[1] |= (5 << GPIO_AFRH_AFSEL13_Pos); // SCL

	// Set GPIO PB14 and PC0 to output mode
	GPIOB->MODER &= ~(GPIO_MODER_MODER14_Msk);
	GPIOC->MODER &= ~(GPIO_MODER_MODER0_Msk);
	GPIOB->MODER |= (1 << GPIO_MODER_MODER14_Pos);
	GPIOC->MODER |= (1 << GPIO_MODER_MODER0_Pos);

	// Set pins PB14 and PC0 to push-pull
	GPIOB->OTYPER &= ~GPIO_OTYPER_OT_14;
	GPIOC->OTYPER &= ~GPIO_OTYPER_OT_0;

	// Set pins PB14 and PC0 to High
	GPIOB->ODR |= GPIO_ODR_14;
	GPIOC->ODR |= GPIO_ODR_0;

	// Set the I2C2 clock speed to 100kHz
	I2C2->TIMINGR |= (0x1 << I2C_TIMINGR_PRESC_Pos);
	I2C2->TIMINGR |= (0x13 << I2C_TIMINGR_SCLL_Pos);
	I2C2->TIMINGR |= (0xF << I2C_TIMINGR_SCLH_Pos);
	I2C2->TIMINGR |= (0x2 << I2C_TIMINGR_SDADEL_Pos);
	I2C2->TIMINGR |= (0x4 << I2C_TIMINGR_SCLDEL_Pos);

	// Enable the I2C2 Peripheral
	I2C2->CR1 |= I2C_CR1_PE;

	config_blue();
	config_orange();
	config_red();
	config_green();

  /* USER CODE END Init */

  /* Configure the system clock */
  SystemClock_Config();

  /* Initialize all configured peripherals */

  /* Infinite loop */
  /* USER CODE BEGIN WHILE */

	gyro_ok = config_gyro();

	int16_t rot_x;
	int16_t rot_y;

  while (1)
  {
    /* USER CODE END WHILE */

		update_leds_from_gyro_data(rot_x, rot_y);

		HAL_Delay(100);

  }
}

void SystemClock_Config(void)
{
  RCC_OscInitTypeDef RCC_OscInitStruct = {0};
  RCC_ClkInitTypeDef RCC_ClkInitStruct = {0};

  /** Initializes the RCC Oscillators according to the specified parameters
  * in the RCC_OscInitTypeDef structure.
  */
  RCC_OscInitStruct.OscillatorType = RCC_OSCILLATORTYPE_HSI;
  RCC_OscInitStruct.HSIState = RCC_HSI_ON;
  RCC_OscInitStruct.HSICalibrationValue = RCC_HSICALIBRATION_DEFAULT;
  RCC_OscInitStruct.PLL.PLLState = RCC_PLL_NONE;
  if (HAL_RCC_OscConfig(&RCC_OscInitStruct) != HAL_OK)
  {
    Error_Handler();
  }

  /** Initializes the CPU, AHB and APB buses clocks
  */
  RCC_ClkInitStruct.ClockType = RCC_CLOCKTYPE_HCLK|RCC_CLOCKTYPE_SYSCLK
                              |RCC_CLOCKTYPE_PCLK1;
  RCC_ClkInitStruct.SYSCLKSource = RCC_SYSCLKSOURCE_HSI;
  RCC_ClkInitStruct.AHBCLKDivider = RCC_SYSCLK_DIV1;
  RCC_ClkInitStruct.APB1CLKDivider = RCC_HCLK_DIV1;

  if (HAL_RCC_ClockConfig(&RCC_ClkInitStruct, FLASH_LATENCY_0) != HAL_OK)
  {
    Error_Handler();
  }
}

void Error_Handler(void)
{
  __disable_irq();
  while (1)
  {
  }
}
